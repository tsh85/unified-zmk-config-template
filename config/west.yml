## config/west.yml
```yaml
manifest:
  defaults:
    revision: main
  remotes:
    - name: zmkfirmware
      url-base: https://github.com/zmkfirmware
    - name: caksoylar
      url-base: https://github.com/caksoylar
    - name: badjeff
      url-base: https://github.com/badjeff
    - name: elekit-official
      url-base: https://github.com/elekit-official
  projects:
    - name: zmk
      remote: zmkfirmware
      revision: 83bc82dbfdcda4ef392461202534a7cc337ca055
      import: app/west.yml
    - name: zmk-rgbled-widget
      remote: caksoylar
      revision: e6b467792a1dabef8cfa5c9fd26bfefc9c16662b
    - name: zmk-pmw3610-driver
      remote: badjeff
      revision: 44b4a76b74d293a93cec4ccb7e04cb8d29c10f93
    - name: zmk_encoder
      remote: elekit-official
      revision: 1a34a5561f08eb7130823760fe597458f477e6db
      path: modules/zmk_encoder
  self:
    path: config
```
